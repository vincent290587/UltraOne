## project-spec/configs/rootfsconfigs/Kconfig.user
```kconfig
menu "user packages " 
config dnf  
	 bool "dnf"
	 help
	
config e2fsprogs-resize2fs  
	 bool "e2fsprogs-resize2fs"
	 help
	
config gpio-demo  
	 bool "gpio-demo"
	 help
	
config mesa-megadriver  
	 bool "mesa-megadriver"
	 help
	
config packagegroup-petalinux-xrt  
	 bool "packagegroup-petalinux-xrt"
	 help
	
config parted  
	 bool "parted"
	 help
	
config peekpoke  
	 bool "peekpoke"
	 help
	
config shells-for-testing-peripheral-devices  
	 bool "shells-for-testing-peripheral-devices"
	 help
	
config wifi-init  
	 bool "wifi-init"
	 help
	
config xrt-dev  
	 bool "xrt-dev"
	 help
	
endmenu
```

## project-spec/meta-user/conf/layer.conf
```bitbake
# We have a conf and classes directory, add to BBPATH
BBPATH .= ":${LAYERDIR}"

# We have recipes-* directories, add to BBFILES
BBFILES += "${LAYERDIR}/recipes-*/*/*.bb \
	${LAYERDIR}/recipes-*/*/*.bbappend"

# Define dynamic layers
BBFILES_DYNAMIC += " \
xilinx-tools:${LAYERDIR}/meta-xilinx-tools/recipes-*/*/*.bbappend \
"

BBFILE_COLLECTIONS += "meta-user"
BBFILE_PATTERN_meta-user = "^${LAYERDIR}/"
BBFILE_PRIORITY_meta-user = "7"
LAYERSERIES_COMPAT_meta-user = "scarthgap"

IMAGE_INSTALL:append = " nano cmake tmux alsa-utils packagegroup-core-buildessential git"

IMAGE_INSTALL:append = " lmsensors-sensors lmsensors-libsensors lmsensors-sensorsdetect"

IMAGE_INSTALL:append = " libupnp-dev"

IMAGE_INSTALL:append = " kernel-devsrc kernel-dev"
```
